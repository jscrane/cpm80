#include <Arduino.h>
#include <keyboard.h>
#include <ps2drv.h>
#include <hardware.h>

#if !defined(USE_OWN_KBD)
#include "kbd.h"
#include "ps2_kbd.h"

// ascii map for scan-codes
static const uint8_t scanmap[] = {
	0xff, 0xff, 0xff, 0xff, 0xff, 0xff, 0xff, 0xff,	 // 0x00
	0xff, 0xff, 0xff, 0xff, 0xff, 0x09, 0x60, 0xff,	 // 0x08
	0xff, 0xff, 0xff, 0xff, 0xff, 0x71, 0x31, 0xff,	 // 0x10
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	0xff, 0x2b, 0x33, 0x2d, 0x2a, 0x39, 0xff, 0xff,	 // 0x78
};

static const uint8_t shiftmap[] = {
	0xff, 0xff, 0xff, 0xff, 0xff, 0xff, 0xff, 0xff,	 // 0x00
	0xff, 0xff, 0xff, 0xff, 0xff, 0x09, 0x60, 0xff,	 // 0x08
	0xff, 0xff, 0xff, 0xff, 0xff, 0x51, 0x21, 0xff,	 // 0x10
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	0xff, 0x2b, 0x33, 0x2d, 0x2a, 0x39, 0xff, 0xff,	 // 0x78
};

bool ps2kbd::modifier(unsigned scan, bool is_down) {
	if (!Keyboard::isshift(scan) && !Keyboard::isctrl(scan))
		return false;
	if (Keyboard::isshift(scan))
		_shift = is_down;
	else
		_ctrl = is_down;
	return true;
}

uint8_t ps2kbd::read() {
	for (;;) {
		while (!ps2.available()) {
#if !defined(Energia_h)
			yield();
#endif
		}
		unsigned scan = ps2.read2();
		uint8_t key = scan & 0xff;
		bool down = is_down(scan);
		if (!modifier(key, down) && !down) {
			uint8_t k = (_shift? shiftmap[key]: scanmap[key]);
			if (k != 0xff) {
				if (_ctrl)
					return _shift? k-0x40: k-0x60;
				return k;
			}
		}
	}
}

uint8_t ps2kbd::avail() {
	while (ps2.available()) {
		unsigned scan = ps2.peek();
		uint8_t key = (scan & 0xff);
		bool down = is_down(scan);
		if (modifier(key, down) || !down)
			ps2.read2();
		else
			return 0xff;
	}
	return 0x00;
}

void ps2kbd::reset() {
	_shift = _ctrl = false;
}
#endif
